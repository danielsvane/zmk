## app/dts/bindings/behaviors/zmk,behavior-hold-tap.yaml
```yaml
# Copyright (c) 2020 The ZMK Contributors
# SPDX-License-Identifier: MIT

description: Hold or Tap behavior

compatible: "zmk,behavior-hold-tap"

include: two_param.yaml

properties:
  bindings:
    type: phandles
    required: true
  tapping-term-ms:
    type: int
  tapping_term_ms:
    type: int
    deprecated: true
  quick-tap-ms:
    type: int
    default: -1
  quick_tap_ms:
    type: int
    deprecated: true
  global-quick-tap:
    type: boolean
    deprecated: true
  require-prior-idle-ms:
    type: int
    default: -1
  flavor:
    type: string
    required: false
    default: "hold-preferred"
    enum:
      - "hold-preferred"
      - "balanced"
      - "tap-preferred"
      - "tap-unless-interrupted"
  hold-while-undecided:
    type: boolean
  hold-while-undecided-linger:
    type: boolean
  retro-tap:
    type: boolean
  hold-trigger-key-positions:
    type: array
    required: false
    default: []
  hold-trigger-on-release:
    type: boolean
  runtime-editable:
    type: boolean
    description: |
      Marks this instance as part of the runtime-editable spare pool
      (CONFIG_ZMK_BEHAVIOR_RUNTIME_EDITING). Its config is placed in RAM and
      registered as a Studio custom-behaviour slot. Not for hand-written keymaps.
  runtime-default-active:
    type: boolean
    description: |
      Marks a runtime-editable instance as a FACTORY slot: it boots claimed
      (active) with its devicetree config + display-name, so it shows up in the
      Studio Behaviours tab editable out of the box and can be bound from a
      shipped keymap by node label (e.g. &hrml). A user can edit or delete it;
      a deleted factory slot is tombstoned so it stays gone across reboots, and
      restore-stock-settings brings it back. Requires runtime-editable. Factory
      nodes live in the customer's shield/board, not the generic spare pool.
```

## app/dts/bindings/behaviors/zmk,behavior-sticky-key.yaml
```yaml
# Copyright (c) 2020 The ZMK Contributors
# SPDX-License-Identifier: MIT

description: Sticky key behavior

compatible: "zmk,behavior-sticky-key"

include: one_param.yaml

properties:
  bindings:
    type: phandles
    required: true
  release-after-ms:
    type: int
    required: true
  quick-release:
    type: boolean
  lazy:
    type: boolean
  ignore-modifiers:
    type: boolean
  runtime-editable:
    type: boolean
    description: |
      Marks this instance as part of the runtime-editable spare pool
      (CONFIG_ZMK_BEHAVIOR_RUNTIME_EDITING). Its config is placed in RAM and
      registered as a Studio custom-behaviour slot. Not for hand-written keymaps.
```
